#INCLUDE "P16F877A.INC"
__config _XT_OSC & _WDT_OFF & _LVP_OFF & _CP_OFF & _BODEN_OFF & _PWRTE_ON

DEC1	EQU	0X20
DEC2	EQU	0X21
CUENTA	EQU 0X22


		ORG 0X00


CONF:
		BCF		STATUS,RP1
		BSF		STATUS,RP0  ;estamos en banco 1
		MOVLW 	0x06
		MOVWF	ADCON1    ; paso de analogico a digital
		CLRF	INTCON		; deshabilito las interrupciones
		MOVLW	b'10000000'	
		MOVWF	TRISB		;dejamos el bit 7 como entrada y el resto como salida
		BCF		STATUS,RP0 ;estamos en banco 0

PRINCIPAL:
		CLRF	CUENTA
IRDER:
		CALL	LLAVE	; TESTEA LA LLAVE DEL PUERTOB
		MOVF	CUENTA,W 
		CALL 	TABLA
		MOVWF	PORTB		; W a portb
		INCF	CUENTA,F
		BTFSC	PORTB,0	; SE FIJA SI LLEGO EL "0" AL BIT 0 DE SALIDA
		GOTO	IRDER		; SI NO ES ASI SE SIGUE ROTANDO A LA DERECHA
IRIZQ:						;CASO CONTRARIO COMIENZA LA ROTACION HACIA LA IZQUIERDA
		CALL	LLAVE			; TESTEA LA LLAVE DEL PUERTOB	
		MOVF	CUENTA,W
		CALL	TABLA
		MOVWF	PORTB
		DECF	CUENTA,F
		BTFSC	PORTB,6	; SE FIJA SI LLEGO EL "0" AL BIT 6 DE SALIDA
		GOTO	IRIZQ		; SI NO ES ASI SE SIGUE ROTANDO A LA IZQUIERDA
		GOTO	IRDER		;CASO CONTRARIO COMIENZA LA ROTACION HACIA LA DERECHA
		
LLAVE:	
		BTFSS	PORTB,7	; si el bit es 1 el retardo es de 100ms
		CALL	ESPERAR	; en el caso contrario
		CALL	ESPERAR	; el retardo sera el doble osea 200ms
		RETURN
TABLA:
		ADDWF 	PCL,F
		RETLW	B'10111111'	
		RETLW	B'11011111'
		RETLW	B'11101111'
		RETLW	B'11110111'
		RETLW	B'11111011'
		RETLW	B'11111101'
		RETLW	B'11111110'	

ESPERAR:

SIGO3:
		MOVLW 0X64
		MOVWF DEC2
SIGO2:
		MOVLW 0XF9
		MOVWF DEC1
SIGO:
		NOP
		DECFSZ DEC1,F
		GOTO SIGO
		DECFSZ DEC2,F
		GOTO SIGO2
	
		RETURN

		END


