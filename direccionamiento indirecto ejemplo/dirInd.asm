#INCLUDE "P16F877A.INC"

CUENTA EQU	0X30
REG1	EQU	0X20
REG2	EQU	0X21
REG3	EQU	0X22
REG4	EQU	0X23
REG5	EQU	0X24
REG6	EQU	0X25
REG7	EQU	0X26
REG8	EQU	0X27
REG9	EQU	0X28
REG10	EQU	0X29



		
		ORG 0X00

CONF:
		BCF		STATUS,RP1
		BSF		STATUS,RP0  ;estamos en banco 1
		MOVLW 	0x06
		MOVWF	ADCON1    ; paso de analogico a digital	
		CLRF	INTCON		; deshabilito las interrupciones
		CLRF	TRISB
		BCF		STATUS,RP0	;estamos en el banco 0

CARGAR:	
		MOVLW	0X40
		MOVWF	REG1
		MOVLW	0X41
		MOVWF	REG2
		MOVLW	0X42
		MOVWF	REG3
		MOVLW	0X43
		MOVWF	REG4
		MOVLW	0X44
		MOVWF	REG5
		MOVLW	0X45
		MOVWF	REG6
		MOVLW	0X46
		MOVWF	REG7
		MOVLW	0X47
		MOVWF	REG8
		MOVLW	0X48
		MOVWF	REG9
		MOVLW	0X49
		MOVWF	REG10

PEINCIPAL:
		MOVLW	D'10'
		MOVWF	CUENTA
		MOVLW	0X20
		MOVWF	FSR
SIGO:
		MOVF	INDF,W
		MOVWF	PORTB
		INCF	FSR,F
		DECFSZ	CUENTA,F
		GOTO	SIGO
		END	
		
	