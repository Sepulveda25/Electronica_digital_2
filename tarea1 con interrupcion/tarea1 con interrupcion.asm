INCLUDE "P16F877A.INC"

CONTROL	EQU 0X20
RB		EQU	0X21
CUENTA	EQU	0X22
CERO	EQU	0X23
STATUS_TEMP	EQU	0X24
W_TEMP	EQU	0X25

	ORG 0X00
	GOTO INICIO
	ORG	0X04
	MOVWF	W_TEMP
	SWAPF	W_TEMP,F
	SWAPF	STATUS,W
	MOVWF	STATUS_TEMP
	
	BTFSC	INTCON,TMR0IF
	GOTO	TIEMPO
	BTFSC	INTCON,INTF
	GOTO	INTRB0
	GOTO	RECUPERAR

TIEMPO
	DECFSZ	CONTROL,F
	GOTO	SIGO
	BCF		CERO,0
SIGO
	MOVLW	D'156'
	MOVWF	TMR0
	BCF		INTCON,TMR0IF
	GOTO 	RECUPERAR
INTRB0
	BCF		INTCON,INTF
	BTFSC	RB,0
	GOTO	UNO
	GOTO	CEROS
UNO	
	BSF		RB,0
	GOTO	RECUPERAR
CEROS
	BCF		RB,0
	GOTO	RECUPERAR
RECUPERAR
	SWAPF	STATUS_TEMP,W
	MOVWF	STATUS
	SWAPF	W_TEMP,W
	RETFIE
INICIO:
	BANKSEL	TRISB
	MOVLW	B'01000101'
	MOVWF	OPTION_REG
	MOVLW	B'00000001'
	MOVWF	TRISB
	MOVLW	B'10110000'
	MOVWF	INTCON
	MOVLW	D'156'
	MOVWF	TMR0
	BANKSEL	PORTB
	MOVLW	D'13'
	MOVWF	CUENTA
	
PRINCIPAL:
	BTFSC	CERO,0
	GOTO	PRINCIPAL
	BTFSS	RB,0
	GOTO	SIMPLE
	GOTO 	DOBLE
SIMPLE
	MOVLW	D'10'
	MOVWF	CONTROL
	GOTO	SEGUIR
DOBLE	
	MOVLW	D'20'
	MOVWF	CONTROL
	GOTO	SEGUIR
SEGUIR
	BCF		CERO,0
	MOVF	CUENTA,W
	CALL	TABLA
	MOVWF	PORTB
	DECFSZ	CUENTA,F
	GOTO	PRINCIPAL
	MOVLW	D'13'
	MOVWF	CUENTA
	GOTO 	PRINCIPAL
	
TABLA
	ADDWF	PCL,F
	RETLW	B'01111111'	
	RETLW	B'10111111'
	RETLW	B'11011111'
	RETLW	B'11101111'
	RETLW	B'11110111'
	RETLW	B'11111011'
	RETLW	B'11111101'
	RETLW	B'11111011'
	RETLW	B'11110111'
	RETLW	B'11101111'
	RETLW	B'11011111'
	RETLW	B'10111111'
	RETLW	B'01111111'
	END