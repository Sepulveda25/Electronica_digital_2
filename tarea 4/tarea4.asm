#INCLUDE "P16F877A.INC"

CUENTA1 EQU	0X20
CUENTA2	EQU	0X21
VECES	EQU 0X22
P1		EQU	0X23
P2		EQU	0X24
TEMP_W	EQU	0X25
TEMP_STATUS	EQU	0X26
INTERRUPCION	EQU	0X27


	ORG 0X00
	GOTO CONFIGURACION
	
	ORG 0X04
	MOVWF	TEMP_W		;***************************
	SWAPF	STATUS,W	;SE GUARDA W Y STATUS
	MOVWF	TEMP_STATUS	;*****************************

	BANKSEL	PORTA
	BSF		INTERRUPCION,0
	BCF		INTCON,2
	MOVLW	D'8'
	MOVWF	TMR0	

	SWAPF	TEMP_STATUS,W	;**************************************
	MOVWF	STATUS			;SE RECUPERA W Y STATUS
	SWAPF	TEMP_W,F		;
	SWAPF	TEMP_W,W		;**************************************

	RETFIE

CONFIGURACION:
	;INTERRUPCIONES
	BANKSEL	TRISB
	MOVLW	B'10100000'; HABILITO LAS INTERRUPCIONES GLOBALES,DESHABILITO LAS INTERRUPCIONES POR PERIFERICOS HABILITO LAS INTERRUPCIONES POR DESBORDE DE TMR0
	MOVWF	INTCON		;DESHABILITO LAS DE MAS INTERRUPCIONES Y SE PONENE LAS BANDERAS A 0
	;PUERTOS
	MOVLW	0X80	;DEJO AL BIT 7 COMO ENTRADA Y EL RESTO COMO SALIDA
	MOVWF	TRISB	
	;TEMPORIZAR CON TMR0
	MOVLW	B'10000001'
	MOVWF	OPTION_REG
	BANKSEL	PORTA
	MOVLW	D'8'
	MOVWF	TMR0	
	
INICIO:
	MOVLW	D'15'
	MOVWF	CUENTA1
	MOVLW	D'3'
	MOVWF	CUENTA2
	MOVLW	D'11'
	MOVWF	VECES
	CLRF	P1
	CLRF	P2
SIGO:
	MOVF	P1,W	;SUMO LOS PUNTEROS PARA MOVERSE EN LA TABLA
	ADDWF	P2,W	;
	CALL	TABLA	
	MOVWF	PORTB
	INCF	P2,F	
	CALL	ESPERA	;ESPERA HASTA QUE SE PRODUZCA LA INTERRUPCION
	DECFSZ	CUENTA2,F	;CUENTA QUE SE AVANCE SOLO 3 POSICIONES EN LA TABLA
	GOTO	SIGO		
	CLRF	P2
	DECFSZ	VECES,F		; CUENTA QUE LAS 3 POSICIONES ANTERIORES SE REPITAN EN TOTAL 11 CADA UNA
	GOTO 	SIGO
	MOVLW	D'11'
	MOVWF	VECES
	MOVLW	D'3'
	ADDWF	P1,F
	CLRF	P2
	DECFSZ	CUENTA1		;CUENTA QUE SE AVANZE DE A 3 POSICIONES HASTA EL FINAL DE 0 A 15
	GOTO	SIGO
	GOTO	INICIO		;CUANDO EL LED ENCENDIDO FUE Y VOLVIO SE COMIENZA DE NUEVO

TABLA:
	ADDWF	PCL,F
	
	RETLW	B'10111111'
	RETLW	B'10111111'
	RETLW	B'10111111'

	RETLW	B'11011111'
	RETLW	B'10011111'
	RETLW	B'10011111'

	RETLW	B'11101111'
	RETLW	B'11001111'
	RETLW	B'10001111'
	
	RETLW	B'11110111'
	RETLW	B'11100111'
	RETLW	B'11000111'

	RETLW	B'11111011'
	RETLW	B'11110011'
	RETLW	B'11100011'
	
	RETLW	B'11111101'
	RETLW	B'11111001'
	RETLW	B'11110001'
	
	RETLW	B'11111110'
	RETLW	B'11111100'
	RETLW	B'11111000'

	RETLW	B'11111110'
	RETLW	B'11111110'
	RETLW	B'11111100'

	RETLW	B'11111110'
	RETLW	B'11111110'
	RETLW	B'11111110'
	
	RETLW	B'11111101'
	RETLW	B'11111100'
	RETLW	B'11111100'

	RETLW	B'11111011'
	RETLW	B'11111001'
	RETLW	B'11111000'

	RETLW	B'11110111'
	RETLW	B'11110011'
	RETLW	B'11110001'
	
	RETLW	B'11101111'
	RETLW	B'11100111'
	RETLW	B'11100011'

	RETLW	B'11011111'
	RETLW	B'11001111'
	RETLW	B'11000111'

	RETLW	B'10111111'
	RETLW	B'10011111'
	RETLW	B'10001111'

	RETLW	B'10111111'
	RETLW	B'10111111'
	RETLW	B'10011111'

ESPERA:; SE ESPERA A QUE SE PRODUZCA INTERRUPCION POR DESBORDAMIENTO DE TMR0
	BTFSS	INTERRUPCION,0
	GOTO	ESPERA
	BCF		INTERRUPCION,0
	RETURN

	END