#INCLUDE "P16F877A.INC"
__config _XT_OSC & _WDT_OFF & _LVP_OFF & _CP_OFF & _BODEN_OFF & _PWRTE_ON
CUENTA	EQU	0X22
STATUS_TEMP	EQU	0X24
W_TEMP	EQU	0X25

	ORG 0X00
	GOTO INICIO
	ORG	0X04

INTERRUPCION
;	MOVWF	W_TEMP
;	SWAPF	W_TEMP,F
;	SWAPF	STATUS,W
;	MOVWF	STATUS_TEMP
	

	DECFSZ	CUENTA,F
	GOTO	RECUPERAR
	MOVLW	D'100'
	MOVWF	CUENTA
	BTFSC	PORTB,0
	GOTO	CERO
	GOTO	UNO
CERO
	BCF		PORTB,0
	GOTO	RECUPERAR
UNO
	BSF		PORTB,0
	GOTO	RECUPERAR
	

RECUPERAR
	BCF		INTCON,2
	MOVLW	D'102'
	MOVWF	TMR0
;	SWAPF	STATUS_TEMP,W
;	MOVWF	STATUS

;	SWAPF	W_TEMP,W
	RETFIE

INICIO:
	BCF		STATUS,RP1
	BSF		STATUS,RP0
	MOVLW	B'01000101'
	MOVWF	OPTION_REG
	MOVLW	0XFE
	MOVWF	TRISB
	BCF		STATUS,RP0
	MOVLW	B'10100000'
	MOVWF	INTCON
	MOVLW	D'102'
	MOVWF	TMR0
	MOVLW	D'100'
	MOVWF	CUENTA
	BSF		PORTB,0
	
PRINCIPAL:

	GOTO 	PRINCIPAL
	

	END