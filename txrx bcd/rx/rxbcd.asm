;RECEPTOR
#INCLUDE "P16F877A.INC"

__config _XT_OSC & _WDT_OFF & _LVP_OFF & _CP_OFF & _BODEN_OFF & _PWRTE_ON

REG1 	EQU		0X20
REG2	EQU		0X21
REG3	EQU		0X22
RECIVO		EQU		0X23
TEMP_W		EQU		0X24
TEMP_STATUS		EQU		0X25	

	ORG 0X00
	
	GOTO CONFIGURACION

	ORG 0X04
	MOVWF	TEMP_W		;***************************
	SWAPF	STATUS,W	;SE GUARDA W Y STATUS
	MOVWF	TEMP_STATUS	;*****************************

	BANKSEL	RCREG	;**************************************************
	MOVF	RCREG,W	;LO QUE SE RECIVE SE MUESTRA EN EL PUERTOB
	CALL 	TABLA	;PARA MOSTRAR EN UN DISPLAYS
	MOVWF	PORTB	;**************************************************

	SWAPF	TEMP_STATUS,W	;**************************************
	MOVWF	STATUS			;SE RECUPERA W Y STATUS
	SWAPF	TEMP_W,F		;
	SWAPF	TEMP_W,W		;**************************************
	RETFIE
		

	
CONFIGURACION:

	BSF    STATUS,RP0     ; Pongo 1 en el RP0 de status
	BCF    STATUS,RP1       ; Pongo 0 en RP1 y estoy en banco 1.
	BSF		TRISC,7 ;RX SERIAL (ENTRADA)
	BCF		TRISC,6	;TX SERIAL (SALIDA)
	MOVLW	0X19 ; CARGO AL REGISTRO SPBRG CON 25 PARA TENER EL MENOR PORCENTAJE DE BITS ERRADOS SEGUN EL CALCULO
	MOVWF	SPBRG

;COFIGURO SALIDAS
	CLRF	TRISB ; TODAS SALIDAS
	

;CONFIFIRO EL REGISTO TXSTA 
	CLRF	TXSTA
;	BCF		TXSTA,7
	BCF		TXSTA,6;	ES PARA EL 9no BIT (8 BIT EN ESTE CASO)
	BSF		TXSTA,5; HABILITO EL TRANSMISOR
	BSF		TXSTA,2 ;SELECCIONO LA VELOCIDAD ALTA
	BCF		TXSTA,4;LO PONES EN MODO ASINCRONICO

;INTERRUPCION POR RECEPCION	
	BSF		INTCON,7 ; HABILITO LAS INTERRUPCIONES GLOBALES
	BSF		INTCON,6 ; HABILITO LAS INTERRUPCIONES POR PERIFERICOS
	BSF		PIE1,5;HABILITA QUE SE TE INTERRUMPA CUANDO RECIBE

;CONFIGURO EL REGISTRO RCSTA
	BCF    STATUS,RP0     ; Pongo 0 en el RP0 de status y estoy en banco 0.
	BSF		RCSTA,7 ; HABILITO TODO EL MODULO PARA COMUNICACION SERIAL
	BCF		RCSTA,6; DESABILITO RX DEL BIT 9
	BSF		RCSTA,4 ; HABILITO LA RECEPCION 
;*********************************************************************************

	

SIGO:
	
	GOTO	SIGO

TABLA:
		ADDWF	PCL,F
		RETLW	B'01000000';0
		RETLW	B'01111001';1
		RETLW	B'00100100';2
		RETLW	B'00110000';3
		RETLW	B'00011001';4
		RETLW	B'00010010';5
		RETLW	B'00000011';6
		RETLW	B'01111000';7
		RETLW	B'00000000';8
		RETLW	B'00011000';9

		RETLW	B'00001000';A
		RETLW	B'00001001';H
		RETLW	B'01000110';C
		RETLW	B'01000000';D
		RETLW	B'00000110';E
		RETLW	B'00001110';F
;ENVIO:

;	MOVWF		TX
;	MOVF		TX,W	
;	BANKSEL		TXSTA	

;ESPERO			
	
;	BTFSS		TXSTA,1;ESPERA QUE SE HAYA ENVIADO EL BYTE ANTERIOR PARA ENVIAR UNO NUEVO
;	GOTO		ESPERO
;	BANKSEL		TXREG	
;	MOVWF		TXREG;NI BIEN MUEVE W A TXREG  TE LO ENVIA
;	RETURN

	END				




