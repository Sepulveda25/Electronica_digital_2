;Retardo de 1 segundo
#INCLUDE "P16F877A.INC"

__config _XT_OSC & _WDT_OFF & _LVP_OFF & _CP_OFF & _BODEN_OFF & _PWRTE_ON


DEC1	EQU	0X20
DEC2	EQU	0X21
DEC3	EQU 0X22

	
		ORG 0X00


CONF:
		BCF		STATUS,RP1
		BSF		STATUS,RP0  ;estamos en banco 1
		MOVLW 	0x06
		MOVWF	ADCON1    ; paso de analogico a digital	
		CLRF	INTCON		; deshabilito las interrupciones
		MOVLW	b'11111110'
		MOVWF	TRISB
		BCF		STATUS,RP0

COMIENZO:
		BSF		PORTB,0
		CALL	ESPERAR
 		BCF		PORTB,0
		CALL	ESPERAR
		GOTO 	COMIENZO 

ESPERAR:
	
		MOVLW 0X0A
		MOVWF DEC3
SIGO3:	
		MOVLW 0X64
		MOVWF DEC2
SIGO2:
		MOVLW 0XF9
		MOVWF DEC1
SIGO:
		NOP
		DECFSZ DEC1,F
		GOTO SIGO
		DECFSZ DEC2,F
		GOTO SIGO2
		DECFSZ DEC3,F
		GOTO SIGO3
		RETURN
		
		END