;TRANSMISOR
#INCLUDE "P16F877A.INC"

__config _XT_OSC & _WDT_OFF & _LVP_OFF & _CP_OFF & _BODEN_OFF & _PWRTE_ON

REG1 	EQU		0X20
REG2	EQU		0X21
REG3	EQU		0X22
TX		EQU		0X23

TECLA 		EQU	0X30
DEC1		EQU	0X31
DEC2		EQU 0X32
BANDERA		EQU	0X33
TEMP_W		EQU	0X34
TEMP_STATUS	EQU	0X35
COMP1		EQU 0X26
	
	ORG 0X00
	GOTO CONFIGURACION
CONFIGURACION:

	BSF    STATUS,RP0     	; Pongo 1 en el RP0 de status
	BCF    STATUS,RP1       ; Pongo 0 en RP1 y estoy en banco 1.
	BSF		TRISC,7 		;RX SERIAL (ENTRADA)
	BCF		TRISC,6			;TX SERIAL (SALIDA)
	MOVLW	0X19 			; CARGO AL REGISTRO SPBRG CON 25 PARA TENER EL MENOR PORCENTAJE DE BITS ERRADOS SEGUN EL CALCULO
	MOVWF	SPBRG
	
	BCF		PIE1,7;DESHABILITO  INTERRUPCIONES POR PS
;COFIGURO ENTRADAS
	MOVLW	0XF0	
	MOVWF	TRISB	
	CLRF	TRISD
	
;CONFIGURO EL REGISTO TXSTA 
	CLRF	TXSTA
	BCF		TXSTA,6;	ES PARA EL 9no BIT (8 BIT EN ESTE CASO)
	BSF		TXSTA,5; HABILITO EL TRANSMISOR
	BSF		TXSTA,2 ;SELECCIONO LA VELOCIDAD ALTA
	BCF		TXSTA,4;LO PONES EN MODO ASINCRONICO

;CONFIGURO EL REGISTRO RCSTA
	BCF    STATUS,RP0     ; Pongo 0 en el RP0 de status y estoy en banco 0.
	BSF		RCSTA,7 ; HABILITO TODO EL MODULO PARA COMUNICACION SERIAL
	BCF		RCSTA,6; DESABILITO RX DEL BIT 9
	BSF		RCSTA,4 ; HABILITO LA RECEPCION 
;*********************************************************************************

PRINCIPAL

	CALL 	TECLADO ; Llamar a rutina de teclado
	MOVWF	PORTD ; Muestra en display lo que enviamos
	CALL 	ENVIO
	GOTO 	PRINCIPAL ; Ejecucion ciclica del programa
TECLADO 
	CLRF 	TECLA ; Limpiar variable TECLA
	MOVLW 	b'00001110' ; Poner un cero en la primer
	MOVWF 	PORTB ; fila del puerto B (RB0)
CHEC_COL
	BTFSS 	PORTB,4 ; Si la 1er columna es "0"
	GOTO 	ANTIRREBOTES ; salta a la rutina ANTIRREBOTES
	INCF 	TECLA,F ; Si es "1" incrementa TECLA
	BTFSS 	PORTB,5 ; Si la 2da columna es "0"
	GOTO 	ANTIRREBOTES ; salta a la rutina ANTIRREBOTES
	INCF 	TECLA,F ; Si es "1" incrementa TECLA
	BTFSS 	PORTB,6 ; Si la 3er columna es "0"
	GOTO 	ANTIRREBOTES ; salta a la rutina ANTIRREBOTES
	INCF 	TECLA,F ; Si es "1" incrementa TECLA
	BTFSS 	PORTB,7 ; Si la 4ta columna es "0"
	GOTO 	ANTIRREBOTES ; salta a la rutina ANTIRREBOTES
	INCF 	TECLA,F ; Si es "1" incrementa TECLA

	MOVLW 	d'12'  ; testea si recorrio todas las teclas
	SUBWF 	TECLA,W
	BTFSC 	STATUS,Z
	GOTO	TECLADO
	BSF	 	STATUS,C
	RLF		PORTB,F	;se testea la siguiente columna y comienza nuevamente
	GOTO 	CHEC_COL;el testeo de las teclas

ANTIRREBOTES	; testeo si se dejo de presionar la tecla			
	CALL	ESPERAR	
	B1 
		BTFSS	PORTB,4
		GOTO 	B1
	B2 
		BTFSS 	PORTB,5
		GOTO 	B2
	B3 
		BTFSS 	PORTB,6
		GOTO 	B3
	B4 
		BTFSS 	PORTB,7
		GOTO 	B4

		MOVF 	TECLA,W
		CALL 	DECOD_TECLA
		RETURN

DECOD_TECLA
		ADDWF 	PCL,f
		RETLW 	0X01
		RETLW 	0X04
		RETLW 	0X07
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		RETLW 	0X0B

ESPERAR:	; espera de 255mS

SIGO3:
		MOVLW 0XFF
		MOVWF DEC2
SIGO2:
		MOVLW 0XF9
		MOVWF DEC1
SIGOO:
		NOP
		DECFSZ 	DEC1,F
		GOTO 	SIGOO
		DECFSZ 	DEC2,F
		GOTO 	SIGO2
		RETURN

ENVIO:

	MOVWF		TX
	CALL		TABLA
	MOVWF		PORTD   ; Muestra en display lo que enviamos
	MOVF		TX,W	
	BANKSEL		TXSTA	

ESPERO:			
	BTFSS		TXSTA,1;ESPERA QUE SE HAYA ENVIADO EL BYTE ANTERIOR PARA ENVIAR UNO NUEVO
	GOTO		ESPERO
	BANKSEL		TXREG	
	MOVWF		TXREG;NI BIEN MUEVE W A TXREG  TE LO ENVIA
	RETURN


TABLA:
		ADDWF	PCL,F
		RETLW	B'01000000';0
		RETLW	B'01111001';1
		RETLW	B'00100100';2
		RETLW	B'00110000';3
		RETLW	B'00011001';4
		RETLW	B'00010010';5
		RETLW	B'00000011';6
		RETLW	B'01111000';7
		RETLW	B'00000000';8
		RETLW	B'00011000';9

		RETLW	B'00001000';A
		RETLW	B'00001001';H

	END				